## boards/arm/bitcraze_crazyradio_2/Kconfig
```kconfig
# Bitcraze Crazyradio 2.0 board configuration

# Copyright (c) 2022 Bitcraze AB
# Copyright (c) 2020 Nordic Semiconductor ASA
# SPDX-License-Identifier: Apache-2.0

config BOARD_ENABLE_DCDC
	bool "DCDC mode"
	select SOC_DCDC_NRF52X
	default y
	depends on BOARD_BITCRAZE_CRAZYRADIO_2
```

## boards/arm/bitcraze_crazyradio_2/Kconfig.board
```kconfig
# Bitcraze Crazyradio 2.0 board configuration

# Copyright (c) 2022 Bitcraze AB
# Copyright (c) 2020 Nordic Semiconductor ASA
# SPDX-License-Identifier: Apache-2.0

config BOARD_BITCRAZE_CRAZYRADIO_2
	bool "Bitcraze Crazyradio 2.0"
	depends on SOC_NRF52840_QIAA
```

## boards/arm/bitcraze_crazyradio_2/Kconfig.defconfig
```kconfig
# Bitcraze Crazyradio 2.0 board configuration

# Copyright (c) 2022 Bitcraze AB
# Copyright (c) 2020 Nordic Semiconductor ASA
# SPDX-License-Identifier: Apache-2.0

if BOARD_BITCRAZE_CRAZYRADIO_2

config BOARD
	default "Bitcraze Crazyradio 2.0"

config BT_CTLR
	default BT

endif # BOARD_BITCRAZE_CRAZYRADIO_2
```

## boards/arm/bitcraze_crazyradio_2/bitcraze_crazyradio_2_defconfig
```kconfig
# SPDX-License-Identifier: Apache-2.0

CONFIG_SOC_SERIES_NRF52X=y
CONFIG_SOC_NRF52840_QIAA=y
CONFIG_BOARD_BITCRAZE_CRAZYRADIO_2=y

# Enable MPU
CONFIG_ARM_MPU=y

# Enable hardware stack protection
CONFIG_HW_STACK_PROTECTION=y

# Enable RTT
CONFIG_USE_SEGGER_RTT=y

# enable GPIO
CONFIG_GPIO=y

# enable uart driver
CONFIG_SERIAL=y

# enable console
CONFIG_CONSOLE=y
CONFIG_UART_CONSOLE=y

# additional board options
CONFIG_GPIO_AS_PINRESET=y

CONFIG_PINCTRL=y

CONFIG_CLOCK_CONTROL_NRF_K32SRC_RC=y
CONFIG_NRFX_CLOCK_LFXO_TWO_STAGE_ENABLED=n

# We use NFC pins to interface with the FEM
CONFIG_NFCT_PINS_AS_GPIOS=y

# SPI used by the fem
CONFIG_SPI=y
```

## boards/bitcraze/crazyradio2/Kconfig.crazyradio2
```kconfig
# Copyright (c) 2025 Bitcraze AB
#
# SPDX-License-Identifier: Apache-2.0

config BOARD_CRAZYRADIO2
        select SOC_NRF52840_QIAA
```

## boards/bitcraze/crazyradio2/Kconfig.defconfig
```kconfig
# Crazyradio 2.0 NRF52840 board configuration
#
# Copyright (c) 2025 Bitcraze AB
#
# SPDX-License-Identifier: Apache-2.0

if BOARD_CRAZYRADIO2

config HW_STACK_PROTECTION
	default ARCH_HAS_STACK_PROTECTION

# Crazyradio 2.0 has the Adafruit UF2 bootloader. Setting load offset where the bootloader expects it

config FLASH_LOAD_OFFSET
	default 0x00026000

# Build UF2 image by default

config BUILD_OUTPUT_UF2
	default y

config BUILD_OUTPUT_UF2_FAMILY_ID
	default "0xada52840"

endif # BOARD_CRAZYRADIO2
```

## boards/bitcraze/crazyradio2/board.yml
```yaml
board:
  name: crazyradio2
  full_name: Crazyradio 2.0
  vendor: bitcraze
  socs:
  - name: nrf52840
```

## boards/bitcraze/crazyradio2/crazyradio2_nrf52840_defconfig
```kconfig
# SPDX-License-Identifier: Apache-2.0

# Enable MPU
CONFIG_ARM_MPU=y

# enable GPIO
CONFIG_GPIO=y

# enable SPI, required for the FEM
CONFIG_SPI=y

# Crazyradio 2.0 does not have a 32kHz crystal, enable internal RC
CONFIG_CLOCK_CONTROL_NRF_K32SRC_RC=y
```

## tools/west.yml
```yaml
manifest:
  self:
    path: crazyradio2-firmware

  remotes:
    - name: zephyrproject-rtos
      url-base: https://github.com/zephyrproject-rtos

  projects:
    - name: zephyr
      remote: zephyrproject-rtos
      revision: v4.2.0
      import: false
      west-commands: scripts/west-commands.yml
    - name: cmsis
      remote: zephyrproject-rtos
      revision: 512cc7e895e8491696b61f7ba8066b4a182569b8
      path: modules/hal/cmsis
      groups:
        - hal
    - name: cmsis_6
      repo-path: CMSIS_6
      remote: zephyrproject-rtos
      revision: 06d952b6713a2ca41c9224a62075e4059402a151
      path: modules/hal/cmsis_6
      groups:
        - hal
    - name: hal_nordic
      remote: zephyrproject-rtos
      revision: 9587b1dcb83d24ab74e89837843a5f7d573f7059
      path: modules/hal/nordic
      groups:
        - hal
    - name: segger
      remote: zephyrproject-rtos
      revision: cf56b1d9c80f81a26e2ac5727c9cf177116a4692
      path: modules/debug/segger
      groups:
        - debug
```
